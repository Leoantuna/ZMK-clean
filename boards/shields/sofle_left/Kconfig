## west.yml
```yaml
manifest:
  remotes:
    - name: zmkfirmware
      url-base: https://github.com/zmkfirmware

  projects:
    - name: zmk
      remote: zmkfirmware
      revision: main  # puedes usar otra rama si lo deseas
      import: app/west.yml

  self:
    path: .
```
